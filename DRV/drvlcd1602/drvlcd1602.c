#include "drvlcd1602.h"


//---------------------------------------------------------------------------------------------------------------------------------------------
//	函 数 名: LCD1602_GPIO_Config
//	功能说明: LCD1602 GPIO配置
//	形    参: 无
//	返 回 值: 无
//	日    期: 
//	作    者: 
//  备    注: 
//---------------------------------------------------------------------------------------------------------------------------------------------
void LCD1602_GPIO_Config(void)
{
	GPIO_InitTypeDef gp_init;
	
	RCC_APB2PeriphClockCmd(LCD1602_CLK, ENABLE);	//GPIO使能
	
	gp_init.GPIO_Mode 	= GPIO_Mode_Out_PP;	//推挽输出
	gp_init.GPIO_Speed 	= GPIO_Speed_10MHz;	//速度配置
	gp_init.GPIO_Pin 	=  LCD1602_E | LCD1602_RS | LCD1602_RW ;	//功能IO
	GPIO_Init(LCD1602_GPIO_PORT,&gp_init);
	
	gp_init.GPIO_Mode 	= GPIO_Mode_Out_OD;	//开漏输出
	gp_init.GPIO_Pin 	=  DB0 | DB1 | DB2 |DB3 | DB4 | DB5| DB6 |  DB7 ; 	//数据IO    //设置为开漏输出 
	GPIO_Init(LCD1602_GPIO_PORT,&gp_init);
}

//---------------------------------------------------------------------------------------------------------------------------------------------
//	函 数 名: LCD1602_WaitReady
//	功能说明: LCD1602 GPIO 忙检测
//	形    参: 无
//	返 回 值: 无
//	日    期: 
//	作    者: 
//  备    注: 
//---------------------------------------------------------------------------------------------------------------------------------------------
void LCD1602_WaitReady(void) //检测忙状态
{
	uint8_t sta;

	GPIOB->ODR =0x00FF;
	RS_SET(0);
	RW_SET(1);
	EN_SET(1);
	SysTick_Delay_Us(1);
	do{
		sta=GPIO_ReadInputDataBit(LCD1602_GPIO_PORT,GPIO_Pin_7);	//判断数据D7的状态
		EN_SET(0);
	}while(sta);
}

/*********************************************************/
// 1602液晶写命令函数，cmd就是要写入的命令
/*********************************************************/
void lcd_write_cmd(uint8_t cmd) //写指令
{
	LCD1602_WaitReady();
	RS_SET(0);
	RW_SET(0);
	EN_SET(0);
	SysTick_Delay_Us(1);
	EN_SET(1);
	LCD1602_GPIO_PORT->ODR &= (cmd|0xFF00);
	EN_SET(0);
	SysTick_Delay_Us(400);
}

/*********************************************************/
// 1602液晶写数据函数，dat就是要写入的数据
/*********************************************************/
void lcd_write_dat(uint8_t dat) //写数据
{
	LCD1602_WaitReady();
	RS_SET(1);
	RW_SET(0);
	SysTick_Delay_Us(30);
	EN_SET(1);
	LCD1602_GPIO_PORT->ODR &=(dat|0xFF00);
	EN_SET(0);
	SysTick_Delay_Us(400);
}

/*********************************************************/
// 1602 坐标设置, 2 X 16
/*********************************************************/
void LCD1602_SetCursor(uint8_t y, uint8_t x)
{
    uint8_t addr;
    
    if (y == 0)  //由输入的屏幕坐标计算显示RAM的地址
	{
        addr = 0x00 + x;  //第一行字符地址从0x00起始
	}
    else
	{
        addr = 0x40 + x;  //第二行字符地址从0x40起始
	}
    lcd_write_cmd(addr|0x80);  //设置RAM地址
}

void LCD1602_ShowStr(uint8_t x, uint8_t y, uint8_t *str, uint8_t len)
{
    LCD1602_SetCursor(x, y);	//设置起始地址
    while (len--)         //连续写入len个字符数据
    {
        lcd_write_dat(*str++);
    }
}

//---------------------------------------------------------------------------------------------------------------------------------------------
//	函 数 名: lcd_dis_str
//	功能说明: LCD1602 显示字符
//	形    参: row: 行; col: 列; length: 显示数据的长度; *str: 显示的数据
//	返 回 值: 无
//	日    期: 
//	作    者: QYQX
//  备    注: RS=H, RW=H, D0-D7指令, EN = 高脉冲(上升沿或下降沿)
//---------------------------------------------------------------------------------------------------------------------------------------------
void lcd_dis_str(unsigned char row, unsigned char col, unsigned char length, unsigned char *str)
{
	unsigned char i;
    unsigned char ddram[2] = {0x80, 0xC0};    //液晶屏上下两行起始位置
	
    if ((row > 1) || (col > 15))
    {
        return ;
    }
	
	 lcd_write_cmd(ddram[row] | col); //设置显示起始位置
	//输出字符串
	for (i = 0; i < length; i++)
    {
        lcd_write_dat(str[i]);
    }
}

//---------------------------------------------------------------------------------------------------------------------------------------------
//	函 数 名: lcd_show_num
//	功能说明: LCD1602 显示数字
//	形    参: num: 显示内容; num_len: 显示的数据长度
//	返 回 值: 无
//	日    期: 
//	作    者: by Q
//  备    注: 
//---------------------------------------------------------------------------------------------------------------------------------------------
void lcd_show_num(uint32_t num, uint8_t num_len)
{
	if (num_len == 1)
	{
		lcd_write_dat(num + 48); 
	}
	else if (num_len == 2)
	{
		lcd_write_dat(num/10 + 48);		// 十位
		lcd_write_dat(num%10 + 48); 	// 个位
	}
	else if (num_len == 3)
	{
		lcd_write_dat(num/100 + 48);		// 百位
		lcd_write_dat(num%100/10 + 48);		// 十位
		lcd_write_dat(num%100%10 + 48); 	// 个位
	}
}

//---------------------------------------------------------------------------------------------------------------------------------------------
//	函 数 名: LCD_ShowNum
//	功能说明: LCD1602 显示数字
//	形    参: x: 列; y: 行; num: 数字
//	返 回 值: 无
//	日    期: 
//	作    者: 
//  备    注: 
//---------------------------------------------------------------------------------------------------------------------------------------------          
void LCD_ShowNum(uint8_t x, uint8_t y, uint8_t num)
{     
	LCD1602_SetCursor(x, y);	//设置起始地址
	LCD_ShowChar(x, y, num + '0');
	
} 

//---------------------------------------------------------------------------------------------------------------------------------------------
//	函 数 名: LCD_ShowChar
//	功能说明: LCD1602 显示数字
//	形    参: x: 列; y: 行; dat: 字符
//	返 回 值: 无
//	日    期: 
//	作    者: 
//  备    注: 
//---------------------------------------------------------------------------------------------------------------------------------------------          
void LCD_ShowChar(uint8_t x, uint8_t y,uint8_t dat)
{
	LCD1602_SetCursor(x, y);	//设置起始地址
	lcd_write_dat(dat);
}

//---------------------------------------------------------------------------------------------------------------------------------------------
//	函 数 名: LCD1602_Init
//	功能说明: LCD1602 显示初始化
//	形    参: 无
//	返 回 值: 无
//	日    期: 
//	作    者: 
//  备    注: 
//---------------------------------------------------------------------------------------------------------------------------------------------          
void LCD1602_Init(void)
{
	LCD1602_GPIO_Config();   //开启GPIO口
    lcd_write_cmd(0X38);  //16*2显示，5*7点阵，8位数据接口
    lcd_write_cmd(0x0C);  //显示器开，光标关闭
    lcd_write_cmd(0x06);  //文字不动，地址自动+1
    lcd_write_cmd(0x01);  //清屏
}
